/*
Final Control of Arduino Joysticks 1 & 2.
*/
const int SW_Pin_p1 = 4;
const int X_Pin_p1 = 1;
const int Y_Pin_p1 = 0;
const int SW_Pin_p2 = 2;
const int X_Pin_p2 = 5;
const int Y_Pin_p2 = 4;
int y_p1 = 0;
int y_p2 = 0;
void setup() {
  pinMode(SW_Pin_p1, INPUT);
  digitalWrite(SW_Pin_p1, HIGH);
  pinMode(SW_Pin_p2, INPUT);
  digitalWrite(SW_Pin_p2, HIGH);
  Serial.begin(9600);
}

void loop() {
  y_p1 = analogRead(Y_Pin_p1)
  if(y_p1 >520 && y_p1<=790){
    Serial.print("UPS:");
    Serial.print("\n");
  }
  else if (y_p1 > 790){
    Serial.print("UPF:");
    Serial.print("\n");
  }
  else if (y_p1<510 && y_p1 >= 260){
    Serial.print("DOWNS:");
    Serial.print("\n");
  }
  else if (y_p1 <260 ){
    Serial.print("DOWNF:");
    Serial.print("\n");
  }
  y_p2 = analogRead(Y_Pin_p2);
  // 4. Replace the value here to fit the neutral range of your particular controller
  if(y_p2 >510 && y_p2 <= 780){
    Serial.print("UPS:");
    Serial.print("\n");
  }
  else if (y_p2 >780){
    Serial.print("UPF:");
    Serial.print("\n");
  }
  else if (y_p2<500 && y_p2>=250){
    Serial.print("DOWNS:");
    Serial.print("\n");
  }
  else if(y_p2< 250){
    Serial.print("DOWNF:");
    Serial.print("\n");
  }
  /***************** DO NOT CHANGE BELOW THIS LINE******************/
  /*****************************************************************/
  delay(50);
}
